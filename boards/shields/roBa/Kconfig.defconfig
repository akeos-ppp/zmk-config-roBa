## boards/shields/roBa/Kconfig.defconfig
```kconfig
# Copyright (c) 2024 The ZMK Contributors
# SPDX-License-Identifier: MIT

# ========================================
# RIGHT SIDE - CENTRAL
# ========================================

if SHIELD_ROBA_R

config ZMK_KEYBOARD_NAME
    default "roBaish"

config ZMK_BLE
    default y

config ZMK_SPLIT_ROLE_CENTRAL
    default y

# PAW3222 trackball is mounted on the right side.
config ZMK_POINTING
    default y

config INPUT
    default y

config SPI
    default y

config PAW3222
    default y

endif # SHIELD_ROBA_R


# ========================================
# LEFT SIDE - PERIPHERAL
# ========================================

if SHIELD_ROBA_L

# Keep pointing enabled so shared keymap mouse behaviors can build cleanly.
# No physical pointing sensor is enabled on the left side.
config ZMK_POINTING
    default y

config INPUT
    default y

endif # SHIELD_ROBA_L


# ========================================
# COMMON SETTINGS
# ========================================

if SHIELD_ROBA_R || SHIELD_ROBA_L

config NFCT_PINS_AS_GPIOS
    default y

config ZMK_SPLIT
    default y

# RGB LED settings
config RGBLED_WIDGET_BATTERY_LEVEL_HIGH
    default 30

config RGBLED_WIDGET_BATTERY_LEVEL_CRITICAL
    default 10

endif # SHIELD_ROBA_R || SHIELD_ROBA_L
```

## config/west.yml
```yaml
manifest:
  remotes:
    - name: zmkfirmware
      url-base: https://github.com/zmkfirmware
    - name: kumamuk-git
      url-base: https://github.com/kumamuk-git
    - name: prospector
      url-base: https://github.com/t-ogura
    - name: sekigon-gonnoc
      url-base: https://github.com/sekigon-gonnoc
    - name: akeos-ppp
      url-base: https://github.com/akeos-ppp
  projects:
    - name: zmk
      remote: zmkfirmware
      revision: v0.3-branch
      import: app/west.yml
    - name: zmk-pmw3610-driver
      remote: kumamuk-git
      revision: main
    - name: prospector-zmk-module
      remote: prospector
      revision: v1.1.1
      path: modules/prospector-zmk-module
    - name: zmk-driver-iqs7211e
      remote: akeos-ppp
      revision: master
  self:
    path: config
```
